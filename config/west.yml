## config/west.yml
```yaml
manifest:
  remotes:
    # zmk official
    - name: zmkfirmware
      url-base: https://github.com/zmkfirmware
      # bravekarma
    # - name: caksoylar
      # url-base: https://github.com/caksoylar
      # kyek / duckyb
    - name: sellswordsoftware
      url-base: https://github.com/SellswordSoftware
  projects:
    - name: zmk
      remote: zmkfirmware
      revision: v0.3.0
      import: app/west.yml
    - name: urchin-module
      remote: sellswordsoftware
      revision: main
  self:
    path: config
```
